## src/netstatus/Kconfig
```kconfig
############################################################################
# telemetron/apps/netstatus/Kconfig
# --------------------------------------------------------------------------
# Author: Art Navsegda <artnavsegda@gmail.com>
#
# Объявление настроек приложения netstatus
# для возможности их изменения через утилиту `make menuconfig`.
#
# Используемая в `make menuconfig` консольная утилита не поддерживает
# отображение русских символов, поэтому, русский язык допустим только
# в составе комментариев и внутри ---help--- разделов, которые
# данной утилитой не отображаются, но из которых можно сформировать html
#
# --------------------------------------------------------------------------
# Синтаксис данного файла описан по ссылке:
#   https://www.kernel.org/doc/Documentation/kbuild/kconfig-language.txt
############################################################################


############################################################################
# Добавление пункта меню в список Telemetron Apps
############################################################################
menuconfig TELEMETRON_APP_NETSTATUS

	# то, что в кавычках - текст добавляемого пункта меню
	bool "netstatus - PutAppDescriptionHere"

	# Должно ли данное приложение быть подключено по-умолчанию.
	# Возможные значения: 'y' и 'n'
	default n

	# Далее следует описание, которое может быть использовано разными
	# GUI редакторами конфига, однако консольный Kconfig данное описание игнорирует
	---help---
		Приложение netstatus. Краткое описание приложения. Заголовок.

		Описание приложения



if TELEMETRON_APP_NETSTATUS
############################################################################
# Описание настраиваемых параметров библиотеки
############################################################################


# Имя исполняемого файла программы, если проект собирается не в виде монолитного
# ядра с интегрированными приложениями, а в виде отдельных исполняемых файлов
# (elf или nxflat)
config TELEMETRON_APP_NETSTATUS_PROGNAME
	string "Program name"
	default "netstatus"
	depends on BUILD_KERNEL
	---help---
		This is the name of the program that will be use when the NSH ELF
		program is installed.

# Стандартный приоритет приложения при запуске через NSH
config TELEMETRON_APP_NETSTATUS_PRIORITY
	int "netstatus task priority"
	default 100

# Стандартный размер стека приложения при запуске через NSH
config TELEMETRON_APP_NETSTATUS_STACKSIZE
	int "netstatus stack size"
	default 2048

endif
```
